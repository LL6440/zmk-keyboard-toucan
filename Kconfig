## dts/bindings/input_processors/zmk,input-processor-absolute-rel-pointer.yaml
```yaml
# SPDX-License-Identifier: MIT

description: Convert absolute trackpad coordinates to relative cursor deltas

compatible: "zmk,input-processor-absolute-rel-pointer"

include: ip_zero_param.yaml

properties:
  pressure-threshold:
    type: int
    default: 8
    description: Minimum ABS_Z value considered an active touch.

  x-div:
    type: int
    default: 8
    description: Raw X delta divider before emitting REL_X steps.

  y-div:
    type: int
    default: 8
    description: Raw Y delta divider before emitting REL_Y steps.

  max-rel:
    type: int
    default: 40
    description: Clamp for a single emitted relative step to avoid jumps.

  invert-x:
    type: boolean
    description: Invert REL_X output.

  invert-y:
    type: boolean
    description: Invert REL_Y output.
```

## dts/bindings/input_processors/zmk,input-processor-circular-scroll.yaml
```yaml
# Copyright (c) 2024 Toucan Keyboard Contributors
# SPDX-License-Identifier: MIT

description: |
  Circular gesture scroll input processor for ZMK.

  Detects circular motion on a trackpad using angular momentum and
  converts it to WHEEL / HWHEEL events on all layers.

  After detection the processor estimates the circle centre via an
  exponential moving average of the finger position, and computes
  the tangential component relative to that centre. This ensures
  scroll direction stays consistent throughout the full revolution,
  regardless of where on the trackpad the gesture starts.

compatible: "zmk,input-processor-circular-scroll"

include: base.yaml

properties:
  "#input-processor-cells":
    type: int
    required: true
    const: 0

  track-remainders:
    type: boolean
    description: |
      Required by ZMK's input_listener to generate DT macros.
      Leave unset — the processor manages its own accumulator.

  detect-samples:
    type: int
    default: 15
    description: |
      Y-events to observe before classifying the gesture (~150 ms at 100 Hz).

  tang-threshold:
    type: int
    default: 200
    description: |
      Minimum |angular momentum| to classify as circular motion.
      Lower = triggers more easily. Higher = requires a more deliberate circle.

  scroll-divisor:
    type: int
    default: 419
    description: |
      Ticks per revolution ~= 2*pi*1000 / scroll-divisor
        419 -> ~15 ticks/rev  (default)
        628 -> ~10 ticks/rev  (slower)
        314 -> ~20 ticks/rev  (faster)

  touch-timeout-ms:
    type: int
    default: 200
    description: |
      Inactivity timeout (ms) in DETECT / POINTER mode.

  scroll-lock-timeout-ms:
    type: int
    default: 500
    description: |
      Inactivity timeout (ms) when scroll mode is locked.
      Long enough to survive a pause in circular motion,
      short enough to detect a genuine finger lift.

  invert-vertical:
    type: boolean
    description: Invert INPUT_REL_WHEEL sign.

  invert-horizontal:
    type: boolean
    description: Invert INPUT_REL_HWHEEL sign.
```

## dts/bindings/input_processors/zmk,input-processor-edge-scroll.yaml
```yaml
# SPDX-License-Identifier: MIT

description: Zone-based edge scroll for absolute trackpads

compatible: "zmk,input-processor-edge-scroll"

include: ip_zero_param.yaml

properties:
  right-zone-pct:
    type: int
    default: 18
    description: Percentage width of the right edge that starts vertical scrolling.

  top-zone-pct:
    type: int
    default: 18
    description: Percentage height of the top edge that starts horizontal scrolling.

  pressure-threshold:
    type: int
    default: 8
    description: Minimum ABS_Z value considered an active touch.

  scroll-div:
    type: int
    default: 16
    description: Raw absolute delta divider before emitting one wheel step.

  x-max:
    type: int
    default: 2047
    description: Maximum X coordinate expected from the trackpad.

  y-max:
    type: int
    default: 1535
    description: Maximum Y coordinate expected from the trackpad.

  invert-vertical:
    type: boolean
    description: Invert wheel output for vertical edge scroll.

  invert-horizontal:
    type: boolean
    description: Invert hwheel output for horizontal edge scroll.
```

## dts/bindings/input_processors/zmk,input-processor-touch-button.yaml
```yaml
# SPDX-License-Identifier: MIT

description: Convert ABS_Z touch transitions into BTN_TOUCH key events

compatible: "zmk,input-processor-touch-button"

include: ip_zero_param.yaml

properties:
  pressure-threshold:
    type: int
    default: 8
    description: Minimum ABS_Z value considered an active touch.
```

## dts/bindings/input_processors/zmk,input-processor-touch-tap.yaml
```yaml
description: |
  Software tap detector for Cirque absolute touchpads.

compatible: "zmk,input-processor-touch-tap"

include: ip_zero_param.yaml

properties:
  pressure-threshold:
    type: int
    required: true
    description: Minimum ABS_Z value considered an active touch.
  max-tap-ms:
    type: int
    required: false
    default: 180
    description: Maximum touch duration to still count as a tap.
  move-threshold:
    type: int
    required: false
    default: 28
    description: Maximum per-axis ABS travel allowed for a tap gesture.
```
